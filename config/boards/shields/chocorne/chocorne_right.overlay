#include "chocorne.dtsi"

&default_transform {
    col-offset = <6>;
};

&kscan0 {
    diode-direction = "col2row";
    col-gpios
        = <&pro_micro 14 GPIO_ACTIVE_HIGH> // COL6
        , <&pro_micro 15 GPIO_ACTIVE_HIGH> // COL7
        , <&pro_micro 18 GPIO_ACTIVE_HIGH> // COL8
        , <&pro_micro 19 GPIO_ACTIVE_HIGH> // COL9
        , <&pro_micro 20 GPIO_ACTIVE_HIGH> // COL10
        , <&pro_micro 21 GPIO_ACTIVE_HIGH> // COL11
        ;
    row-gpios
        = <&pro_micro 5 (GPIO_ACTIVE_HIGH | GPIO_PULL_DOWN)> // ROW0
        , <&pro_micro 6 (GPIO_ACTIVE_HIGH | GPIO_PULL_DOWN)> // ROW1
        , <&pro_micro 7 (GPIO_ACTIVE_HIGH | GPIO_PULL_DOWN)> // ROW2
        , <&pro_micro 8 (GPIO_ACTIVE_HIGH | GPIO_PULL_DOWN)> // ROW3
        ;
};
